/*
 * Copyright (c) 2020 Pete Johanson
 *
 * SPDX-License-Identifier: MIT
 */

#include "corne.dtsi"

&kscan0 {
    col-gpios
        = <&gpio0 14 GPIO_ACTIVE_HIGH>  // d14 (leftmost column)
        , <&gpio0 15 GPIO_ACTIVE_HIGH>  // d15
        , <&gpio0 18 GPIO_ACTIVE_HIGH>  // d18
        , <&gpio0 19 GPIO_ACTIVE_HIGH>  // d19
        , <&gpio0 20 GPIO_ACTIVE_HIGH>  // d20
        , <&gpio0 21 GPIO_ACTIVE_HIGH>  // d21 (rightmost column)
        ;
};
